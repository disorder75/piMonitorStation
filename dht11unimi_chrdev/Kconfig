## dht11unimi_chrdev/Kconfig
```kconfig
menu "DHT11 Temperature and Humidy driver sensor"

config DHT11_UNIMI
	tristate "DHT11 Unimi driver"
	depends on GPIOLIB || COMPILE_TEST
	default m
	help
	  Device driver support sensors DHT11 from UniMi-SSRI
	  Driver will use GPIO pins defined by the device tree
	  
endmenu
```

## dht11unimi_chrdev/raspberry/linux/drivers/misc/Kconfig.patch
```kconfig
diff --git a/drivers/misc/Kconfig b/drivers/misc/Kconfig
index 1f3d3f2171c6..37a9c7e9b072 100644
--- a/drivers/misc/Kconfig
+++ b/drivers/misc/Kconfig
@@ -535,4 +535,18 @@ source "drivers/misc/echo/Kconfig"
 source "drivers/misc/cxl/Kconfig"
 source "drivers/misc/ocxl/Kconfig"
 source "drivers/misc/cardreader/Kconfig"
+source "drivers/misc/dht11unimi/Kconfig"
+
+config DUMMY_CODE
+	tristate "Dummy Code - UniMi Project"
+	default n
+	---help---
+		This code is just for demostration, experimental for UniMi project
+
+config IRQTEST_CODE
+	tristate "Simple IRQ test - UniMi Project"
+	default n
+	---help---
+		The irqtest module for demostration, experimental for UniMi project.
+
 endmenu
```

## dht11unimi_chrdev/raspberry/linux/drivers/misc/dht11unimi/Kconfig
```kconfig
menu "DHT11 Temperature and Humidity driver sensor"

config DHT11_UNIMI
	tristate "DHT11 Unimi driver"
	depends on GPIOLIB || COMPILE_TEST
	default m
	help
	  Device driver support sensors DHT11 from UniMi-SSRI
	  Driver will use GPIO pin defined into the device tree
	  
endmenu
```
